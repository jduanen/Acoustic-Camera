`timescale 1ns / 1ps

// Bit-exact check of cic_decimator.v against fpga/cluster/golden/cic_golden.py's
// cic_bitexact(), at a small fast-sim config and at the real STAGES=5/R=64
// config. Vectors are generated by fpga/cluster/golden/gen_vectors.py -- these
// localparams must stay in sync with CIC_CONFIGS there.
module tb_cic_decimator;
    localparam integer N_SMALL_IN  = 1200;
    localparam integer N_SMALL_OUT = 300;
    localparam integer N_REAL_IN   = 32000;
    localparam integer N_REAL_OUT  = 500;

    localparam integer W_SMALL = 1 + 2 * 2; // IN_WIDTH=1 + STAGES*ceil(log2(R)) = 1+2*2=5
    localparam integer W_REAL  = 1 + 5 * 6; // 1+5*6=31

    reg clk = 0;
    reg rst = 1;
    always #5 clk = ~clk;

    // ---- small config (STAGES=2, R=4) ----
    reg  mem_small_in  [0:N_SMALL_IN-1];
    reg  [W_SMALL-1:0] mem_small_exp [0:N_SMALL_OUT-1];
    reg  [31:0] idx_small = 0;
    reg  [31:0] out_idx_small = 0;
    wire data_in_small = (idx_small < N_SMALL_IN) ? mem_small_in[idx_small] : 1'b0;
    wire [W_SMALL-1:0] data_out_small;
    wire valid_small;

    cic_decimator #(.STAGES(2), .R(4), .IN_WIDTH(1)) dut_small (
        .clk(clk), .rst(rst), .data_in(data_in_small),
        .data_out(data_out_small), .valid(valid_small)
    );

    // ---- real config (STAGES=5, R=64) ----
    reg  mem_real_in  [0:N_REAL_IN-1];
    reg  [W_REAL-1:0] mem_real_exp [0:N_REAL_OUT-1];
    reg  [31:0] idx_real = 0;
    reg  [31:0] out_idx_real = 0;
    wire data_in_real = (idx_real < N_REAL_IN) ? mem_real_in[idx_real] : 1'b0;
    wire [W_REAL-1:0] data_out_real;
    wire valid_real;

    cic_decimator #(.STAGES(5), .R(64), .IN_WIDTH(1)) dut_real (
        .clk(clk), .rst(rst), .data_in(data_in_real),
        .data_out(data_out_real), .valid(valid_real)
    );

    integer errors = 0;

    initial begin
        $readmemb("../vectors/cic_small_input.mem", mem_small_in);
        $readmemh("../vectors/cic_small_expected.mem", mem_small_exp);
        $readmemb("../vectors/cic_real_input.mem", mem_real_in);
        $readmemh("../vectors/cic_real_expected.mem", mem_real_exp);
    end

    // verify the DUTs' own internal WIDTH parameter matches the Hogenauer bound
    initial begin
        if (dut_small.WIDTH !== W_SMALL) begin
            $display("FAIL: dut_small.WIDTH=%0d expected %0d", dut_small.WIDTH, W_SMALL);
            errors = errors + 1;
        end
        if (dut_real.WIDTH !== W_REAL) begin
            $display("FAIL: dut_real.WIDTH=%0d expected %0d", dut_real.WIDTH, W_REAL);
            errors = errors + 1;
        end
    end

    // input index advance, one bit/cycle
    always @(posedge clk) begin
        if (rst) begin
            idx_small <= 0;
            idx_real  <= 0;
        end else begin
            if (idx_small < N_SMALL_IN) idx_small <= idx_small + 1;
            if (idx_real  < N_REAL_IN)  idx_real  <= idx_real + 1;
        end
    end

    // output capture/compare, every cycle
    always @(posedge clk) begin
        if (!rst) begin
            #1;
            if (valid_small) begin
                if (out_idx_small < N_SMALL_OUT) begin
                    if (data_out_small !== mem_small_exp[out_idx_small]) begin
                        $display("FAIL: small[%0d] got %0d expected %0d",
                                 out_idx_small, data_out_small, mem_small_exp[out_idx_small]);
                        errors = errors + 1;
                    end
                    out_idx_small <= out_idx_small + 1;
                end
            end
            if (valid_real) begin
                if (out_idx_real < N_REAL_OUT) begin
                    if (data_out_real !== mem_real_exp[out_idx_real]) begin
                        $display("FAIL: real[%0d] got %0d expected %0d",
                                 out_idx_real, data_out_real, mem_real_exp[out_idx_real]);
                        errors = errors + 1;
                    end
                    out_idx_real <= out_idx_real + 1;
                end
            end
        end
    end

    initial begin
        rst = 1;
        repeat (4) @(negedge clk);
        rst = 0;

        // run long enough for the real (longer) config to finish + a margin
        repeat (N_REAL_IN + 100) @(posedge clk);
        #1;

        if (out_idx_small !== N_SMALL_OUT) begin
            $display("FAIL: small config produced %0d/%0d expected outputs", out_idx_small, N_SMALL_OUT);
            errors = errors + 1;
        end
        if (out_idx_real !== N_REAL_OUT) begin
            $display("FAIL: real config produced %0d/%0d expected outputs", out_idx_real, N_REAL_OUT);
            errors = errors + 1;
        end

        if (errors == 0) begin
            $display("PASS: tb_cic_decimator, small(%0d) + real(%0d) outputs all bit-exact",
                      N_SMALL_OUT, N_REAL_OUT);
            $finish;
        end else begin
            $display("FAIL: tb_cic_decimator, %0d errors", errors);
            $finish;
        end
    end
endmodule
